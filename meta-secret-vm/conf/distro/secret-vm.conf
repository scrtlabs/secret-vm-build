## meta-secret-vm/conf/distro/secret-vm.conf
```bitbake
DISTRO = "secret-vm"
DISTRO_NAME = "SecretVM"
DISTRO_VERSION = "v0.0.25-beta.0"
DISTRO_FEATURES:append = " systemd usrmerge virtualization"

DISTROOVERRIDES = "poky:secret-vm"

VIRTUAL-RUNTIME_init_manager = "systemd"
VIRTUAL-RUNTIME_dev_manager = "systemd"
VIRTUAL-RUNTIME_initscripts = ""

PREFERRED_RPROVIDER_sshd = "dropbear"
```

## meta-secret-vm/conf/layer.conf
```bitbake
# We have a conf and classes directory, add to BBPATH
BBPATH .= ":${LAYERDIR}"

# We have recipes-* directories, add to BBFILES
BBFILES += "${LAYERDIR}/recipes-*/*/*.bb \
            ${LAYERDIR}/recipes-*/*/*.bbappend"

BBFILE_COLLECTIONS += "meta-secret-vm"
BBFILE_PATTERN_meta-secret-vm = "^${LAYERDIR}/"
BBFILE_PRIORITY_meta-secret-vm = "10"

LAYERDEPENDS_meta-secret-vm = "core openembedded-layer meta-python"
LAYERSERIES_COMPAT_meta-secret-vm = "scarthgap"
```

## meta-secret-vm/conf/machine/secret-vm-gcp-tdx.conf
```bitbake
require conf/machine/qemux86-64.conf

PREFERRED_PROVIDER_virtual/kernel = "linux-upstream"
PREFERRED_VERSION_virtual/kernel = "6.16%"
WKS_FILE = "gcp.wks"

MACHINE_FEATURES += "gcp-tdx"
```

## meta-secret-vm/conf/machine/secret-vm-sev.conf
```bitbake
require conf/machine/qemux86-64.conf

PREFERRED_PROVIDER_virtual/kernel = "linux-amdese"
PREFERRED_VERSION_virtual/kernel ?= "6.16%"

PREFERRED_PROVIDER_virtual/ovmf = "secret-vm-ovmf-sev"

MACHINE_FEATURES += "sev"
```

## meta-secret-vm/conf/machine/secret-vm-tdx.conf
```bitbake
require conf/machine/qemux86-64.conf

PREFERRED_PROVIDER_virtual/kernel = "linux-upstream"
PREFERRED_VERSION_virtual/kernel = "6.16%"

PREFERRED_PROVIDER_virtual/ovmf = "secret-vm-ovmf-tdx"

MACHINE_FEATURES += "tdx"
```

## meta-secret-vm/wic/gcp.wks
```
part /boot --source bootimg-efi --ondisk sda --fstype=vfat --label boot --active --align 1024 --sourceparams="loader=grub-efi,initrd=secret-vm-initramfs-${MACHINE}.rootfs.${INITRAMFS_FSTYPES}" --use-uuid
part / --source rootfs --ondisk sdb --fstype=ext4 --label root --active --align 1024 --use-uuid
bootloader --ptable gpt --timeout=0 --append="console=ttyS0 loglevel=7 initrd=initrd"
```

## meta-secretai/conf/distro/secretai.conf
```bitbake
DISTRO = "secretai"
DISTRO_NAME = "SecretAI"
DISTRO_FEATURES:append = " systemd usrmerge virtualization"

DISTROOVERRIDES = "poky:secretai"

PREFERRED_PROVIDER_virtual/kernel = "linux-yocto-dev"
PREFERRED_VERSION_linux-yocto-dev ?= "6.9%"

VIRTUAL-RUNTIME_init_manager = "systemd"
VIRTUAL-RUNTIME_dev_manager = "systemd"
VIRTUAL-RUNTIME_initscripts = ""
```

## meta-secretai/conf/layer.conf
```bitbake
# We have a conf and classes directory, add to BBPATH
BBPATH .= ":${LAYERDIR}"

# We have recipes-* directories, add to BBFILES
BBFILES += "${LAYERDIR}/recipes-*/*/*.bb \
            ${LAYERDIR}/recipes-*/*/*.bbappend"

BBFILE_COLLECTIONS += "meta-secretai"
BBFILE_PATTERN_meta-secretai = "^${LAYERDIR}/"
BBFILE_PRIORITY_meta-secretai = "10"

LAYERDEPENDS_meta-secretai = "core openembedded-layer meta-python"
LAYERSERIES_COMPAT_meta-secretai = "dunfell hardknott honister kirkstone langdale mickledore nanbield scarthgap"
```
